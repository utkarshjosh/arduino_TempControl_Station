#include "DHT.h"
#include <Wire.h>
#include <EEPROM.h>
#include <Adafruit_GFX.h>
#include <Adafruit_SSD1306.h>
#include <Fonts/Org_01.h>


///////////////////////////Loading animation , bitmaps
//const unsigned char PROGMEM loading0 [] = {0x00, 0x00, 0x00, 0x00, 0x00, 0x00, 0x00, 0x00, 0x00, 0x00, 0x00, 0x00, 0x00,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 0x00, 0x00};
//
//const unsigned char PROGMEM loading1 [] = {0x00, 0x00, 0x00, 0x00, 0x00, 0x00, 0x00, 0x00, 0x00, 0x00, 0x00, 0x00, 0x00,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 0x00, 0x00};
//
//const unsigned char PROGMEM loading2 [] = {0x00, 0x00, 0x00, 0x00, 0x00, 0x00, 0x00, 0x00, 0x00, 0x00, 0x00, 0x00, 0x00,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 0x00, 0x00};
//
//const unsigned char PROGMEM loading3 [] = {0x00, 0x00, 0x00, 0x00, 0x00, 0x00, 0x00, 0x00, 0x00, 0x00, 0x00, 0x00, 0x00,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 0x00, 0x00};
//
//const unsigned char PROGMEM loading4 [] = {0x00, 0x00, 0x00, 0x00, 0x00, 0x00, 0x00, 0x00, 0x00, 0x00, 0x00, 0x00, 0x00,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 0x00, 0x00};
//
//const unsigned char PROGMEM loading5 [] = {0x00, 0x00, 0x00, 0x00, 0x00, 0x00, 0x00, 0x00, 0x00, 0x00, 0x00, 0x00, 0x00,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 0x00, 0x00};
//
//const unsigned char PROGMEM loading6 [] = {0x00, 0x00, 0x00, 0x00, 0x00, 0x00, 0x00, 0x00, 0x00, 0x00, 0x00, 0x00, 0x00,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 0x00, 0x00};
//
//const unsigned char PROGMEM loading7 [] = {0x00, 0x00, 0x00, 0x00, 0x00, 0x00, 0x00, 0x00, 0x00, 0x00, 0x00, 0x00, 0x00,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 0x00, 0x00};
//
//const unsigned char PROGMEM loading8 [] = {0x00, 0x00, 0x00, 0x00, 0x00, 0x00, 0x00, 0x00, 0x00, 0x00, 0x00, 0x00, 0x00,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 0x00, 0x00};
//
//const unsigned char PROGMEM loading9 [] = {0x00, 0x00, 0x00, 0x00, 0x00, 0x00, 0x00, 0x00, 0x00, 0x00, 0x00, 0x00, 0x00,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 0x00, 0x00};
//
//const unsigned char PROGMEM loading10 [] = {0x00, 0x00, 0x00, 0x00, 0x00, 0x00, 0x00, 0x00, 0x00, 0x00, 0x00, 0x00, 0x00,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 0x00, 0x00};
//
//const unsigned char PROGMEM loading11 [] = {0x00, 0x00, 0x00, 0x00, 0x00, 0x00, 0x00, 0x00, 0x00, 0x00, 0x00, 0x00, 0x00,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 0x00, 0x00};
//
//const unsigned char PROGMEM loading12 [] = {0x00, 0x00, 0x00, 0x00, 0x00, 0x00, 0x00, 0x00, 0x00, 0x00, 0x00, 0x00, 0x00,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 0x00, 0x00};
//
//const unsigned char PROGMEM loading13 [] = {0x00, 0x00, 0x00, 0x00, 0x00, 0x00, 0x00, 0x00, 0x00, 0x00, 0x00, 0x00, 0x00,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 0x00, 0x00};
//
//const unsigned char PROGMEM loading14 [] = {0x00, 0x00, 0x00, 0x00, 0x00, 0x00, 0x00, 0x00, 0x00, 0x00, 0x00, 0x00, 0x00,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 0x00, 0x00};
//
//const unsigned char PROGMEM loading15 [] = {0x00, 0x00, 0x00, 0x00, 0x00, 0x00, 0x00, 0x00, 0x00, 0x00, 0x00, 0x00, 0x00,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 0x00, 0x00};
//
//const unsigned char PROGMEM loading16 [] = {0x00, 0x00, 0x00, 0x00, 0x00, 0x00, 0x00, 0x00, 0x00, 0x00, 0x00, 0x00, 0x00,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 0x00, 0x00};
//
//const unsigned char PROGMEM loading17 [] = {0x00, 0x00, 0x00, 0x00, 0x00, 0x00, 0x00, 0x00, 0x00, 0x00, 0x00, 0x00, 0x00,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 0x00, 0x00};
//
//const unsigned char PROGMEM loading18 [] = {0x00, 0x00, 0x00, 0x00, 0x00, 0x00, 0x00, 0x00, 0x00, 0x00, 0x00, 0x00, 0x00,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 0x00, 0x00};
//
//const unsigned char PROGMEM loading19 [] = {0x00, 0x00, 0x00, 0x00, 0x00, 0x00, 0x00, 0x00, 0x00, 0x00, 0x00, 0x00, 0x00,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 0x00, 0x00};
//
//const unsigned char PROGMEM loading20 [] = {0x00, 0x00, 0x00, 0x00, 0x00, 0x00, 0x00, 0x00, 0x00, 0x00, 0x00, 0x00, 0x00,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 0x00, 0x00};
//
//const unsigned char PROGMEM loading21 [] = {0x00, 0x00, 0x00, 0x00, 0x00, 0x00, 0x00, 0x00, 0x00, 0x00, 0x00, 0x00, 0x00,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 0x00, 0x00};
//
//const unsigned char PROGMEM loading22 [] = {0x00, 0x00, 0x00, 0x00, 0x00, 0x00, 0x00, 0x00, 0x00, 0x00, 0x00, 0x00, 0x00,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 0x00, 0x00};
//
//const unsigned char PROGMEM loading23 [] = {0x00, 0x00, 0x00, 0x00, 0x00, 0x00, 0x00, 0x00, 0x00, 0x00, 0x00, 0x00, 0x00,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 0x00, 0x00};
//
//const unsigned char PROGMEM loading24 [] = {0x00, 0x00, 0x00, 0x00, 0x00, 0x00, 0x00, 0x00, 0x00, 0x00, 0x00, 0x00, 0x00,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 0x00, 0x00};
//
//const unsigned char PROGMEM loading25 [] = {0x00, 0x00, 0x00, 0x00, 0x00, 0x00, 0x00, 0x00, 0x00, 0x00, 0x00, 0x00, 0x00,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 0x00, 0x00};
//
//const unsigned char PROGMEM loading26 [] = {0x00, 0x00, 0x00, 0x00, 0x00, 0x00, 0x00, 0x00, 0x00, 0x00, 0x00, 0x00, 0x00,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 0x00, 0x00};
//
//const unsigned char PROGMEM loading27 [] = {0x00, 0x00, 0x00, 0x00, 0x00, 0x00, 0x00, 0x00, 0x00, 0x00, 0x00, 0x00, 0x00,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 0x00, 0x00};
//

//////////////////////////////
/////////////////////////////////////birb
const unsigned char PROGMEM birb [] = {0x00, 0x00, 0x00, 0x00, 0x0C, 0x00, 0x00, 0x00, 0x00, 0x00, 0x7F, 0x00, 0x00,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 0x00, 0x00};
////////////////////////////////////////
//const int button_MODE = 3;    // the number of the MODE pin
//const int button_SET = 4;    // the number of the SET pin
int button_MODE_state;
int button_SET_state;    // the current reading from the input pin
int last_MODE_state = LOW;   // the previous reading from the input pin
int last_SET_state=LOW;
// the following variables are unsigned longs because the time, measured in
// milliseconds, will quickly become a bigger number than can be stored in an int.
int MODE_press=0; ///let say it has 3 states.... 0:HOME 1:to set BOTTOM_RANGE  2: to set TOP_RANGE
int SET_press=0; // it defines the +- range about which the temp  , 8 states 
                  //the alteration of the push button (an event of click) is recorded , counted and updated to this variables
unsigned long lastDebounceTime_MODE = 0; 
unsigned long lastDebounceTime_SET = 0; // the last time the output pin was toggled
unsigned long debounceDelay = 50;   
bool MODE_exchange=false;
bool SET_exchange=false;
///////////////////////////////////////////////// Variables for push bottons MODE and SET
int temp_min{18};
int temp_max{30};
///////////////////////////////////////////////
DHT HT(2,DHT11);
float humi;
float tempC;
float tempF;
bool fan_state{false};  
bool lamp_state{false};
// Declaration for an SSD1306 display connected to I2C (SDA, SCL pins)
Adafruit_SSD1306 display(128, 64, &Wire, -1);

void setup() {
 Serial.begin(9600);
  //For DHT11
  HT.begin();
  //For OLED I2C
  if(!display.begin(SSD1306_SWITCHCAPVCC, 0x3C)) { // Address 0x3D for 128x64
    Serial.println(F("SSD1306 allocation failed"));
    for(;;);}
/////////////// MODE AND SET BUTTON setup below
 pinMode(3, INPUT_PULLUP);
 pinMode(4,INPUT_PULLUP);

/////////////////////////////
//  EEPROM.write(0,18);
//  EEPROM.write(1,30);
//  delay(2000);
   temp_min=EEPROM.read(0);
   temp_max=EEPROM.read(1);

 //Display birby
  display.clearDisplay();
  display.drawBitmap(40, 2,birb,48,48, 1);
  display.setCursor(50,56);
  display.setTextSize(1);
  display.setTextColor(WHITE);
  display.print("Birby");
  display.display();
  delay(1500);
  //display loading animation
 humi = HT.readHumidity();
 tempC = HT.readTemperature();
//  loading_animation(40,12,15);
//  loading_animation(40,12,15);
}

void loop() {
 //delay(1000);
 humi = HT.readHumidity();
 tempC = HT.readTemperature();
 //tempF = HT.readTemperature(true);

// Serial.print("Humidity:");
// Serial.print(humi,0);
// Serial.print("%");
// Serial.print(" Temperature:");
// Serial.print(tempC,1);
// Serial.print("C ~ ");
// Serial.print(tempF,1);
// Serial.println("F");

 display.clearDisplay();
 
 button_read();
 if(MODE_press>0){
   setTemp();
 }
 else{
 oledDisplay(2,90,48,humi,"%");
 oledDisplay(2,70,16,tempC,"C");
 oledDisplayFan();  //oledDisplayLamp();
 }

 //regulating temperature using simple latch logic
  if(tempC >=temp_max){
    switchFan(true);
  }
  else if(tempC <=temp_min){
    switchFan(false);
    switchLamp(true);
  }
  if(lamp_state && tempC>= ((temp_max-temp_min)/2)){
    switchLamp(false);
  }
    
}

void oledDisplay(int size, int x,int y, float value, String unit){
 int charLen=12;
 int xo=x+charLen*3.2;
 int xunit=x+charLen*3.6;
 int xval = x; 
 display.setTextSize(size);
 display.setTextColor(WHITE);
 
 if (unit=="%"){
   display.setCursor(x, y);
   display.print(value,0);
   display.print(unit);
 } else {
   if (value>99){
    xval=x;
   } else {
    xval=x+charLen;
   }
   display.setCursor(xval, y);
   display.print(value,0);
   display.drawCircle(xo, y+2, 2, WHITE);  // print degree symbols (  )
   display.setCursor(xunit, y);
   display.print(unit);
 }
}

  void oledDisplayFan(){
//header writing "temperature" and "humidity"
   display.setTextSize(1);
 display.setTextColor(WHITE);
 display.setCursor(60, 0);
 display.print("Temperature");
  display.setCursor(75, 34);
 display.print("Humidity");
  
 display.setCursor(0, 0);
  display.print("FAN");
  display.setCursor(0, 29);
  display.print("LAMP");
  display.setCursor(5,15);
  display.setTextSize(2);
    display.setFont(&Org_01);
    if(fan_state)
    display.print("ON");
    else
    display.print("OFF");
    display.setCursor(5,47);
    if(lamp_state)
    display.print("ON");
    else
    display.print("OFF");
   display.setFont();
   display.display();

   
  }

// void oledDisplayLamp(){
//      display.setTextSize(1);
// 
// display.setTextColor(WHITE);
// display.setCursor(0, 29);
//  display.print("LAMP");
//  display.setCursor(5,42);
//  display.setTextSize(2);
//    display.setFont(&Org_01);
//    if(lamp_state)
//    display.print("ON");
//    else
//    display.print("OFF");
//   display.setFont();
//display.display(); ///modify 16-5,13:20
// }


// void loading_animation(int xx, int yy,int tt){
// for(int i=0;i<=27;i++){
//  display.clearDisplay();
//  
//  display.drawBitmap(xx, yy,loads[i][0],48,48, 1);
//  display.display();
//  delay(tt);
// }
// 
//display.clearDisplay();
//display.drawBitmap(xx, yy,loading0,48,48, 1);
//display.display();
//delay(tt);
//
//display.clearDisplay();
//display.drawBitmap(xx, yy,loading1,48,48, 1);
//display.display();
//delay(tt);
//
//display.clearDisplay();
//display.drawBitmap(xx, yy,loading2,48,48, 1);
//display.display();
//delay(tt);
//
//display.clearDisplay();
//display.drawBitmap(xx, yy,loading3,48,48, 1);
//display.display();
//delay(tt);
//
//display.clearDisplay();
//display.drawBitmap(xx, yy,loading4,48,48, 1);
//display.display();
//delay(tt);
//
//display.clearDisplay();
//display.drawBitmap(xx, yy,loading5,48,48, 1);
//display.display();
//delay(tt);
//
//display.clearDisplay();
//display.drawBitmap(xx, yy,loading6,48,48, 1);
//display.display();
//delay(tt);
//
//display.clearDisplay();
//display.drawBitmap(xx, yy,loading7,48,48, 1);
//display.display();
//delay(tt);
//
//display.clearDisplay();
//display.drawBitmap(xx, yy,loading8,48,48, 1);
//display.display();
//delay(tt);
//
//display.clearDisplay();
//display.drawBitmap(xx, yy,loading9,48,48, 1);
//display.display();
//delay(tt);
//
//display.clearDisplay();
//display.drawBitmap(xx, yy,loading10,48,48, 1);
//display.display();
//delay(tt);
//
//display.clearDisplay();
//display.drawBitmap(xx, yy,loading11,48,48, 1);
//display.display();
//delay(tt);
//
//display.clearDisplay();
//display.drawBitmap(xx, yy,loading12,48,48, 1);
//display.display();
//delay(tt);
//
//display.clearDisplay();
//display.drawBitmap(xx, yy,loading13,48,48, 1);
//display.display();
//delay(tt);
//
//display.clearDisplay();
//display.drawBitmap(xx, yy,loading14,48,48, 1);
//display.display();
//delay(tt);
//
//display.clearDisplay();
//display.drawBitmap(xx, yy,loading15,48,48, 1);
//display.display();
//delay(tt);
//
//display.clearDisplay();
//display.drawBitmap(xx, yy,loading16,48,48, 1);
//display.display();
//delay(tt);
//
//display.clearDisplay();
//display.drawBitmap(xx, yy,loading17,48,48, 1);
//display.display();
//delay(tt);
//
//display.clearDisplay();
//display.drawBitmap(xx, yy,loading18,48,48, 1);
//display.display();
//delay(tt);
//
//display.clearDisplay();
//display.drawBitmap(xx, yy,loading19,48,48, 1);
//display.display();
//delay(tt);
//
//display.clearDisplay();
//display.drawBitmap(xx, yy,loading20,48,48, 1);
//display.display();
//delay(tt);
//
//display.clearDisplay();
//display.drawBitmap(xx, yy,loading21,48,48, 1);
//display.display();
//delay(tt);
//
//display.clearDisplay();
//display.drawBitmap(xx, yy,loading22,48,48, 1);
//display.display();
//delay(tt);
//
//display.clearDisplay();
//display.drawBitmap(xx, yy,loading23,48,48, 1);
//display.display();
//delay(tt);
//
//display.clearDisplay();
//display.drawBitmap(xx, yy,loading24,48,48, 1);
//display.display();
//delay(tt);
//
//display.clearDisplay();
//display.drawBitmap(xx, yy,loading25,48,48, 1);
//display.display();
//delay(tt);
//
//display.clearDisplay();
//display.drawBitmap(xx, yy,loading26,48,48, 1);
//display.display();
//delay(tt);
//
//display.clearDisplay();
//display.drawBitmap(xx, yy,loading27,48,48, 1);
//display.display();
//delay(tt);
// }

void button_read(){

int reading_MODE= digitalRead(3);
int reading_SET;
if(MODE_press>0)
reading_SET= digitalRead(4);

if(reading_MODE!=last_MODE_state){
//  lastDebounceTime_MODE=millis();
if(reading_MODE==LOW) {
    MODE_press++;
    SET_press=0; //since context changes so SET_press has to reset
  MODE_press%=3;  //mode has 3 states
  MODE_exchange=true;
}
}
if(reading_SET!=last_SET_state){
 // lastDebounceTime_SET=millis();
 if(reading_SET==LOW) {
//    SET_press++;
//  SET_press%=8;  
  SET_exchange=true;
}
}
//Serial.print("\nReading_MODE");Serial.print(reading_MODE);
//Serial.print("\nLast_MODE_state");Serial.print(last_MODE_state);
//Serial.print("\nlastDebounceTime_MODE");Serial.print(lastDebounceTime_MODE);
//Serial.print("\nMODE_press");Serial.print(MODE_press);
//if((millis() - lastDebounceTime_MODE) > debounceDelay ){
//  if(reading_MODE!=button_MODE_state){
//    button_MODE_state=reading_MODE;
//  }
//  if(button_MODE_state==LOW){
//  
//  MODE_press++;
//  MODE_press%=3;  //mode has 3 states
//  }
//}
//
//if((millis() - lastDebounceTime_SET) > debounceDelay ){
//  if(reading_SET!=button_SET_state){
//    button_SET_state=reading_SET;
//  }
//  if(button_SET_state==LOW){
//  
//  SET_press++;
//  SET_press%=8;      
//  }
// 
//}
 last_MODE_state=reading_MODE;
  last_SET_state=reading_SET;
}


void setTemp(){
//Mode travelst through and set increments furhter mode saves 
display.clearDisplay();
int low=temp_min;
int high =temp_max;
if(MODE_press==1 && SET_exchange ){
low++;
if(low>26)
low=18;
SET_exchange=false;
temp_min=low;
 EEPROM.update(0, temp_min); 
}

else if(MODE_press==2 && SET_exchange){
high++;
if(high>38)
high=30;
SET_exchange=false;
temp_max=high;
 EEPROM.update(1, temp_max);
 
}

//if(MODE_exchange)
//{temp_min=low;
//temp_max=high;
//MODE_exchange=false;
//}
 display.setTextSize(2);
 display.setTextColor(WHITE);
 display.setCursor(12,3 );
 display.print("Set Range");
 display.setCursor(28,25);
 display.print(low);
  display.setCursor(58,25);
 display.print("-");
 display.setCursor(76,25);
 display.print(high);
 int rectX=25;
 if(MODE_press==2)
  rectX=74;
  display.fillRect(rectX,44, 28,4,WHITE);
 
 display.display();
 
}

void switchFan(bool i){
  digitalWrite(5,i); // Fan relay pin 5
  fan_state=i;
 }
 void switchLamp(bool i){
 digitalWrite(6,i); //Lamp relay pin 6
 lamp_state=i;
 }
 
